## conf/layer.conf
```bitbake
_fsl_bbpath = ""
_fsl_bbpath_mx6 = ":${LAYERDIR}"

_fsl_qt5_bbfilesx = "${@\
  bb.utils.contains('BBFILE_COLLECTIONS', 'qt5-layer', '\
    ${LAYERDIR}/qt5-layer/recipes-*/*/*.bb \
    ${LAYERDIR}/qt5-layer/recipes-*/*/*.bbappend', '', d)} \
"

_fsl_bbfiles = ""
_fsl_bbfiles_mx6 = "\
  ${LAYERDIR}/recipes-*/*/*.bb \
  ${LAYERDIR}/recipes-*/*/*.bbappend \
  ${_fsl_qt5_bbfilesx} \
"

_fsl_collections = ""
_fsl_collections_mx6 = "elito-fsl"

BBPATH .= "${_fsl_bbpath}"
BBFILES += "${_fsl_bbfiles}"
BBFILE_COLLECTIONS   += "${_fsl_collections}"
BBFILE_PATTERN_elito-fsl := "^${LAYERDIR}/"
BBFILE_PRIORITY_elito-fsl =  "101"
```
